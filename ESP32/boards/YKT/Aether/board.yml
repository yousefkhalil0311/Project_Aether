## ESP32/boards/YKT/Aether/board.yml
```yaml
board:
  name: ykt_aether
  full_name: YKT Aether
  vendor: YKT
  socs:
  - name: esp32s3
```

## modules/timeBase/Kconfig
```kconfig
# Create a new option in menuconfig

config TIMEBASE
    bool "Basic get time and write to console"
    default n           # Set library to be disabled by default
    depends on PRINTK   # Needs printk to work
    help
        Adds a writeTime() function to write the current time on
        to the console output.
```
